## app/testcase.yaml
```yaml
# This file is provided so that the application can be compiled using Twister,
# the Zephyr testing tool. In this file, multiple combinations can be specified,
# so that you can easily test all of them locally or in CI.
sample:
  description: sample application
  name: sample-application

common:
  build_only: true

tests:
  sample.mars_5.i3cs:
    integration_platforms:
      - mars_5
    extra_args:
      - CONF_FILE="boards/mars_5/i3cs.conf"
      - EXTRA_DTC_OVERLAY_FILE="boards/mars_5/i3cs.overlay"

  sample.mars_5.i3cm:
    integration_platforms:
      - mars_5
    extra_args:
      - CONF_FILE="boards/mars_5/i3cm.conf"
      - EXTRA_DTC_OVERLAY_FILE="boards/mars_5/i3cm.overlay"

  sample.mars_81.base:
    integration_platforms:
      - mars_81
    extra_args:
      - CONF_FILE="boards/mars_81/base.conf"
      - EXTRA_DTC_OVERLAY_FILE="boards/mars_81/base.overlay"

  sample.mars_81.spi:
    integration_platforms:
      - mars_81
    extra_args:
      - CONF_FILE="boards/mars_81/spi.conf"
      - EXTRA_DTC_OVERLAY_FILE="boards/mars_81/spi.overlay"

  sample.mars_82.base:
    integration_platforms:
      - mars_82
    extra_args:
      - CONF_FILE="boards/mars_82/base.conf"
      - EXTRA_DTC_OVERLAY_FILE="boards/mars_82/base.overlay"
```

## boards/ite/fan_box/Kconfig.defconfig
```kconfig
# Copyright (c) 2026 ITE Corporation. All Rights Reserved.
# SPDX-License-Identifier: Apache-2.0

if BOARD_FAN_BOX

if PM

config PM_DEVICE
	default y

choice PM_POLICY
	default PM_POLICY_CUSTOM
endchoice

endif # PM

endif # BOARD_FAN_BOX
```

## boards/ite/fan_box/Kconfig.fan_box
```kconfig
# Copyright (c) 2026 ITE Corporation. All Rights Reserved.
# SPDX-License-Identifier: Apache-2.0

config BOARD_FAN_BOX
	select SOC_IT82000BW
```

## boards/ite/fan_box/board.yml
```yaml
# Copyright (c) 2026 ITE Corporation.
# SPDX-License-Identifier: Apache-2.0

board:
  name: fan_box
  vendor: ite
  full_name: Fan Box
  socs:
    - name: it82000bw
```

## boards/ite/mars_5/Kconfig.mars_5
```kconfig
# Copyright (c) 2025 ITE Corporation. All Rights Reserved.
# SPDX-License-Identifier: Apache-2.0

config BOARD_MARS_5
	select SOC_IT51526AW
```

## boards/ite/mars_5/board.yml
```yaml
# Copyright (c) 2025 ITE Corporation.
# SPDX-License-Identifier: Apache-2.0

board:
  name: mars_5
  vendor: ite
  full_name: Mars 5
  socs:
    - name: it51526aw
```

## boards/ite/mars_81/Kconfig.defconfig
```kconfig
# Copyright (c) 2025 ITE Corporation.
# SPDX-License-Identifier: Apache-2.0

if BOARD_MARS_81

if PM

config PM_DEVICE
	default y

choice PM_POLICY
	default PM_POLICY_CUSTOM
endchoice

endif # PM

config INPUT
	default y if KSCAN

endif # BOARD_MARS_81
```

## boards/ite/mars_81/Kconfig.mars_81
```kconfig
# Copyright (c) 2025 ITE Corporation. All Rights Reserved.
# SPDX-License-Identifier: Apache-2.0

config BOARD_MARS_81
	select SOC_IT81302BX
```

## boards/ite/mars_81/board.yml
```yaml
# Copyright (c) 2025 ITE Corporation.
# SPDX-License-Identifier: Apache-2.0

board:
  name: mars_81
  vendor: ite
  socs:
    - name: it81302bx
```

## boards/ite/mars_82/Kconfig.defconfig
```kconfig
# Copyright (c) 2025 ITE Corporation. All Rights Reserved.
# SPDX-License-Identifier: Apache-2.0

if BOARD_MARS_82

config INPUT
     default y if KSCAN

endif ## BOARD_MARS_82
```

## boards/ite/mars_82/Kconfig.mars_82
```kconfig
# Copyright (c) 2025 ITE Corporation.
# SPDX-License-Identifier: Apache-2.0

config BOARD_MARS_82
	select SOC_IT82202AX
```

## drivers/Kconfig
```kconfig
# Copyright (c) 2021 Nordic Semiconductor ASA
# SPDX-License-Identifier: Apache-2.0

menu "Drivers"
rsource "col_gpio_drive/Kconfig"
rsource "hwinfo/Kconfig"
rsource "ite_i3c/Kconfig"
endmenu
```

## drivers/col_gpio_drive/Kconfig
```kconfig
# Copyright (c) 2025 ITE Corporation.
# SPDX-License-Identifier: Apache-2.0

if KEYCODE_DETECT

config COL_GPIO_DRIVE
	bool "GPIO driven column keyboard matrix hook"
	depends on KEYCODE_DETECT
	depends on DT_HAS_ITE_COL_GPIO_DRIVE_ENABLED
	default y
	select INPUT_KBD_DRIVE_COLUMN_HOOK
	help
	  Implemnt the hook to handle a keyboard matrix column using a GPIO.

endif #KEYCODE_DETECT
```

## drivers/hwinfo/Kconfig
```kconfig
# Copyright (c) 2025 ITE Corporation.
# SPDX-License-Identifier: Apache-2.0

if HWINFO

config HWINFO_ITE
	bool "ITE SoC Chip ID"
	default y if SOC_IT51XXX || SOC_IT8XXX2
	help
	  Enable ITE hwinfo driver

endif #HWINFO
```

## drivers/ite_i3c/Kconfig
```kconfig
# Copyright (c) 2025 ITE Corporation.
# SPDX-License-Identifier: Apache-2.0

config ITE_I3C_SAMPLE
	bool "ITE I3C sample"
	depends on DT_HAS_ITE_IT51XXX_I3CM_ENABLED || DT_HAS_ITE_IT51XXX_I3CS_ENABLED
	default y
	help
	  Enable the ite i3c sample driver, including tgt mqueue and ctrl dummy device.

if ITE_I3C_SAMPLE

config ITE_I3C_SAMPLE_INIT_PRIORITY
	int "ITE I3C device drivers init priority"
	default KERNEL_INIT_PRIORITY_DEVICE
	help
	  ITE I3C device drivers init priority.

rsource "Kconfig.ctrl_dummy"
rsource "Kconfig.tgt_mqueue"

endif # ITE_I3C_SAMPLE
```

## drivers/ite_i3c/Kconfig.ctrl_dummy
```kconfig
# Copyright (c) 2025 ITE Corporation.
# SPDX-License-Identifier: Apache-2.0

config I3C_CTRL_DUMMY
	bool "I3C controller dummy driver"
	depends on DT_HAS_ITE_I3C_CTRL_DUMMY_ENABLED
	default y if I3CM_IT51XXX

config I3C_CTRL_DUMMY_GETSTATUS_POLLING_MS
	int "the polling time(ms) of GETSTATUS work"
	depends on I3C_CTRL_DUMMY
	default 50
```

## drivers/ite_i3c/Kconfig.tgt_mqueue
```kconfig
# Copyright (c) 2025 ITE Corporation.
# SPDX-License-Identifier: Apache-2.0

config I3C_TGT_MQUEUE
	bool "I3C target message queue driver"
	depends on DT_HAS_ITE_I3C_TGT_MQUEUE_ENABLED
	default y if I3CS_IT51XXX

config I3C_TGT_MQUEUE_STACK_SIZE
	int "the stack size of tgt mqueue thread"
	depends on I3C_TGT_MQUEUE
	default 1024

config I3C_TGT_MQUEUE_THREAD_PRIORITY
	int "the priority of tgt mqueue thread"
	depends on I3C_TGT_MQUEUE
	default 8

config I3C_TGT_MQUEUE_EVENT_COUNT
	int "I3C tgt mqueue event count"
	depends on I3C_TGT_MQUEUE
	range 4 16
	default 4
```

## dts/bindings/input/ite,col-gpio-drive.yaml
```yaml
# Copyright (c) 2025 ITE Corporation. All Rights Reserved.
# SPDX-License-Identifier: Apache-2.0

description: |
  Keyboard matrix device GPIO column drive

  This can be used to handle a specific keyboard matrix column using a GPIO.
  Instantiate as a child node of the keyboard matrix device itself.

  Example configuration:

  &kbd {
      ...
      kso-gpio {
          compatible = "ite,col-gpio-drive";
          col-num = <16>;
          col-gpios = <&gpioa 0 GPIO_ACTIVE_LOW>;
      };
  };

compatible: "ite,col-gpio-drive"

include: base.yaml

properties:
  col-num:
    type: int
    required: true
    description: Column number to handle

  col-gpios:
    type: phandle-array
    required: true
    description: GPIO to use to handle the column

  settle-time-us:
    type: int
    default: 30
    description: |
      Extra delay after changing the column state, note that this adds up to
      the parent device settle-time-us.
```

## tests/spi_test/Kconfig
```kconfig
# Copyright (c) 2025 ITE Corporation.
# SPDX-License-Identifier: Apache-2.0

config SPI_TEST_CLOCK_SOURCE_KHZ
	int "Set SPI Clock Source"
	depends on SPI_TEST
	default 24000 if BOARD_MARS_82 # SSPI freq
	default 24000 if BOARD_MARS_81 # SSPI freq
	default 48000 if BOARD_MARS_5 # PLL freq
	help
	  Set SPI clock source.

config SPI_TEST_JEDEC_ID
	bool "SPI Jedec ID Test"
	depends on SPI_TEST
	default y
	help
	  Enable SPI Jedec ID test.

config SPI_TEST_FREQUENCY
	bool "SPI Frequency Test"
	depends on SPI_TEST
	default y
	help
	  Enable SPI frequency test.

config SPI_TEST_ASYNC_TRANSFER
	bool "SPI Async Transfer Test"
	depends on SPI_TEST
	default y
	help
	  Enable SPI async transfer test.

if SPI_TEST_ASYNC_TRANSFER
config SPI_TEST_ASYNC_STACK_SIZE
	int "Stack Size of SPI Async Transfer"
	default 512
	help
	  Set the stack size of SPI async transfer.
endif # SPI_TEST_ASYNC_TRANSFER

config SPI_TEST_FLASH_ACCESS
	bool "SPI Flash Access Test"
	depends on SPI_TEST
	default y
	help
	  Enable SPI flash access test.

config SPI_TEST_DUAL_MODE
	bool "SPI Dual Mode Test"
	depends on SPI_TEST
	default n if BOARD_MARS_5
	default n if BOARD_MARS_81
	default y
	help
	  Enable SPI dual mode test.

config SPI_TEST_QUAD_MODE
	bool "SPI Qual Mode Test"
	depends on SPI_TEST
	default n if BOARD_MARS_5
	default n if BOARD_MARS_81
	default y
	help
	  Enable SPI qual mode test.

config SPI_TEST_LINE_MODE
	bool "SPI Line Mode Test"
	depends on SPI_TEST
	default n if BOARD_MARS_82
	default n if BOARD_MARS_81
	default y
	help
	  Enable SPI line mode test.

config SPI_TEST_RX_ONLY
	bool "SPI RX Test"
	depends on SPI_TEST
	default y
	help
	  Enable SPI RX test.

config SPI_TEST_TX_ONLY
	bool "SPI TX Test"
	depends on SPI_TEST
	default y
	help
	  Enable SPI TX test.

config SPI_TEST_TX_RX
	bool "SPI TX Then RX Test"
	depends on SPI_TEST
	default y
	help
	  Enable SPI TX then RX test.

config SPI_TEST_PM_CHECK
	bool "SPI PM Check Test"
	depends on SPI_TEST
	default y
	help
	  Enable SPI PM check test.

if SPI_TEST_PM_CHECK
config SPI_TEST_PM_CHECK_STACK_SIZE
	int "Stack Size of SPI PM Check Thread"
	default 1024
	help
	  Set the stack size of SPI PM check thread.
endif # SPI_TEST_PM_CHECK
```

## west.yml
```yaml
# Copyright (c) 2021 Nordic Semiconductor ASA
# SPDX-License-Identifier: Apache-2.0

manifest:
  self:
    west-commands: scripts/west-commands.yml

  remotes:
    - name: zephyrproject-rtos
      url-base: https://github.com/zephyrproject-rtos

  projects:
    - name: zephyr
      remote: zephyrproject-rtos
      revision: 090130c35b5bd0a4fe4dc175b00fcbd1f90cda2a
      import:
        # By using name-allowlist we can clone only the modules that are
        # strictly needed by the application.
        name-allowlist:
          - cmsis      # required by the ARM port
          - hal_nordic # required by the custom_plank board (Nordic based)
          - hal_stm32  # required by the nucleo_f302r8 board (STM32 based)
```

## zephyr/Kconfig
```kconfig
# Copyright (c) 2025 ITE Corporation.
# SPDX-License-Identifier: Apache-2.0

menu "Zephyr"
source "Kconfig.zephyr"
endmenu

rsource "common/Kconfig"
rsource "device/Kconfig"
```

## zephyr/common/Kconfig
```kconfig
# Copyright (c) 2025 ITE Corporation.
# SPDX-License-Identifier: Apache-2.0

module = APP
module-str = APP
source "subsys/logging/Kconfig.template.log_config"

rsource "system_event_log/Kconfig"
rsource "system_info/Kconfig"
```

## zephyr/common/keycode_detect/Kconfig
```kconfig
# Copyright (c) 2025 ITE Corporation.
# SPDX-License-Identifier: Apache-2.0

module = KEYCODE_DETECT
module-str = keycode-detect
source "subsys/logging/Kconfig.template.log_config"

config KEYCODE_DETECT
	bool "enable keycode detect"
	default n
	select INPUT
	help
	  Enable keycode detect.

if KEYCODE_DETECT
config KEYCODE_DETECT_PRIORITY
	int "keycode detect priority"
	default 10
	help
	  Keycode detect priority.

config INPUT_KBD_MATRIX
	default y

endif #KEYCODE_DETECT
```

## zephyr/common/system_event_log/Kconfig
```kconfig
# Copyright (c) 2025 ITE Corporation.
# SPDX-License-Identifier: Apache-2.0

module = SYSTEM_EVENT_LOG
module-str = system-event-log
source "subsys/logging/Kconfig.template.log_config"

config SYS_EVT_LOG_PRIORITY
	int "system event log thread priority"
	default 9
	help
	  System event log thread priority.

config SYS_EVT_LOG_STACK_SIZE
	int "the stack size of system event log thread"
	default 512
	help
	  The stack size of system event log thread.

config SYS_EVT_LOG_MAX_RECORD
	int "the maximum number of system event logs"
	default 10
	range 1 256
	help
	  the maximum number of system event logs that
	  can be recorded.
```

## zephyr/common/system_info/Kconfig
```kconfig
# Copyright (c) 2025 ITE Corporation.
# SPDX-License-Identifier: Apache-2.0

module = SYSTEM_INFO
module-str = system-info
source "subsys/logging/Kconfig.template.log_config"

choice
	prompt "Select FRU storage device"
	default SYSTEM_INFO_FRU_DEVICE_EEPROM if $(dt_alias_enabled,fru-eeprom)
	default SYSTEM_INFO_FRU_DEVICE_FLASH if $(dt_alias_enabled,fru-flash)
	default SYSTEM_INFO_FRU_DEVICE_NONE

config SYSTEM_INFO_FRU_DEVICE_EEPROM
	bool "Use eeprom device for FRU"

config SYSTEM_INFO_FRU_DEVICE_FLASH
	bool "Use flash device for FRU"

config SYSTEM_INFO_FRU_DEVICE_NONE
	bool "No FRU device"
endchoice
```
