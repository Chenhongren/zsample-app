## zephyr/device/Kconfig
```kconfig
# Copyright (c) 2025 ITE Corporation.
# SPDX-License-Identifier: Apache-2.0

rsource "flash/Kconfig"
```

## zephyr/device/flash/Kconfig
```kconfig
# Copyright (c) 2025 ITE Corporation.
# SPDX-License-Identifier: Apache-2.0

module = FLASH_DEVICE
module-str = FLASH_DEVICE
source "subsys/logging/Kconfig.template.log_config"
```

## zephyr/program/fan_box/boards/prj.conf
```kconfig
CONFIG_SHELL=y
CONFIG_LOG=y

CONFIG_HWINFO=y

CONFIG_I2C=y

CONFIG_EEPROM=y
CONFIG_EEPROM_SHELL=y
CONFIG_EEPROM_AT24=y
```

## zephyr/program/mars_5/boards/prj.conf
```kconfig
# Copyright (c) 2025 ITE Corporation.
# SPDX-License-Identifier: Apache-2.0

CONFIG_SHELL=y
CONFIG_LOG=y

CONFIG_FLASH=y
CONFIG_FLASH_SHELL=y

CONFIG_I3C=y
CONFIG_I3C_SHELL=y
CONFIG_LPS2XDF=y
CONFIG_SENSOR=y
CONFIG_SENSOR_SHELL=y
```
